; The file is automatically generated by offline_debug tool
do ~~/t32.cmm
sys.res
sys.cpu CortexA55
sys.u

if os.file("a")
   d.load.e a 0xaaaadf915000 /nc
 if os.file("libc-2.31.so")
   d.load.e libc-2.31.so 0xffffa9f1c000 /nc
 if os.file("ld-2.31.so")
   d.load.e ld-2.31.so 0xffffaa08f000 /nc
 if os.file("core.elf")
   d.load.e core.elf /nc  /ny
menu.rp
(
        add
        menu
        (
                popup "Threads"
                (
                        default
                        menuitem "current:3865"
                        (
                                r.s x0 0x0
                                r.s x1 0x1
                                r.s x2 0xffffc712e068
                                r.s x3 0xaaaadf91571c
                                r.s x4 0x0
                                r.s x5 0x98fe186ed17eb3a4
                                r.s x6 0xffffaa08bb10
                                r.s x7 0x40000000000000
                                r.s x8 0xffffffffffffffff
                                r.s x9 0xfffffffffffffff
                                r.s x10 0x0
                                r.s x11 0x0
                                r.s x12 0xffffa9f1fe48
                                r.s x13 0x0
                                r.s x14 0x0
                                r.s x15 0x6fffff47
                                r.s x16 0x0
                                r.s x17 0x0
                                r.s x18 0x73516240
                                r.s x19 0xaaaadf915738
                                r.s x20 0x0
                                r.s x21 0xaaaadf915610
                                r.s x22 0x0
                                r.s x23 0x0
                                r.s x24 0x0
                                r.s x25 0x0
                                r.s x26 0x0
                                r.s x27 0x0
                                r.s x28 0x0
                                r.s x29 0xffffc712df00
                                r.s x30 0xffffa9f3ce10
                                r.s sp 0xffffc712df00
                                r.s pc 0xaaaadf91572c
                                r.s cpsr 0x60001000
                        )
                )
        )
)


per.s spr:0x30200 %q 0x0000008000000000
per.s spr:0x30202 %q 0x32B5193519
per.s spr:0x30100 %l 0x4C5D93D



setup.v %h.on %s.on %y.on
wclear
wpos 0% 0% 50% 100%
w.v.f /a /l
wpos 50% 0%
w.r
wpos 50% 30%
d.l



r.s x0 0x0
r.s x1 0x1
r.s x2 0xffffc712e068
r.s x3 0xaaaadf91571c
r.s x4 0x0
r.s x5 0x98fe186ed17eb3a4
r.s x6 0xffffaa08bb10
r.s x7 0x40000000000000
r.s x8 0xffffffffffffffff
r.s x9 0xfffffffffffffff
r.s x10 0x0
r.s x11 0x0
r.s x12 0xffffa9f1fe48
r.s x13 0x0
r.s x14 0x0
r.s x15 0x6fffff47
r.s x16 0x0
r.s x17 0x0
r.s x18 0x73516240
r.s x19 0xaaaadf915738
r.s x20 0x0
r.s x21 0xaaaadf915610
r.s x22 0x0
r.s x23 0x0
r.s x24 0x0
r.s x25 0x0
r.s x26 0x0
r.s x27 0x0
r.s x28 0x0
r.s x29 0xffffc712df00
r.s x30 0xffffa9f3ce10
r.s sp 0xffffc712df00
r.s pc 0xaaaadf91572c
r.s cpsr 0x60001000
enddo